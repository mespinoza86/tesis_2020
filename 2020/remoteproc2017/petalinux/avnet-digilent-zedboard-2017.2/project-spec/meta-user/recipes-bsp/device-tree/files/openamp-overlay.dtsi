/ {
	amba {
                elf_ddr_0: ddr@0 {
                        compatible = "mmio-sram";
                        reg = <0x100000 0x100000>;
                };

	};

	remoteproc0: remoteproc@0 {
		compatible = "xlnx,zynq_remoteproc";
		firmware = "firmware";
		vring0 = <15>;
		vring1 = <14>;
		sram_0 = <&elf_ddr_0>;

	};
};
