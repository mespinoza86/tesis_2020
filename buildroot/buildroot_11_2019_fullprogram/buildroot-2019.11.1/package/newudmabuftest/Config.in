## buildroot/buildroot_11_2019_fullprogram/buildroot-2019.11.1/package/newudmabuftest/Config.in
```kconfig
config BR2_PACKAGE_NEWUDMABUFTEST
	bool "newudmabuftest"
	help
		hello world mpi package
```
